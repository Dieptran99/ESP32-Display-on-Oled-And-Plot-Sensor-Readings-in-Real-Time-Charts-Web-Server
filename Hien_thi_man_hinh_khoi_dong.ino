#ifdef ESP32
    #include <WiFi.h>
    #include "time.h"
    #include <ESPAsyncWebServer.h>
    #include <SPIFFS.h>
#else 
    #include <Arduino.h>
    #include <Hash.h>
    #include <ESPAsyncTCP.h>
    #include <ESPAsyncWebServer.h>
    #include <FS.h>
#endif
#include <Wire.h>
#include <Adafruit_Sensor.h>
#include <DHT.h>                                 
#include <Arduino.h>                           
#include <U8g2lib.h>                            

const char* ssid       = "************";     
const char* password   = "************";      

// Create AsyncWebServer object on port 80
AsyncWebServer server(80);

#ifdef U8X8_HAVE_HW_SPI
#include <SPI.h>
#endif

#ifdef U8X8_HAVE_HW_I2C
#include <Wire.h>
#endif

U8G2_SH1106_128X64_NONAME_F_HW_I2C u8g2(U8G2_R0, /* reset=*/ U8X8_PIN_NONE);

U8X8_SH1106_128X64_NONAME_HW_I2C u8x8(/* reset=*/ U8X8_PIN_NONE);

int frame;
int f;

String frameState;

#define DHTPIN 27              // Digital pin connected to the DHT sensor

#define DHTTYPE DHT11          // DHT 11

DHT dht(DHTPIN, DHTTYPE);

String readDHTTemperature() {
  // Sensor readings may also be up to 2 seconds 'old' (its a very slow sensor)
  // Read temperature as Celsius (the default)
  float t = dht.readTemperature();
  // Read temperature as Fahrenheit (isFahrenheit = true)
  //float t = dht.readTemperature(true);
  // Check if any reads failed and exit early (to try again).
  if (isnan(t)) {    
    Serial.println("Failed to read from DHT sensor!");
    return "--";
  }
  else {
    Serial.println(t);
    return String(t);
  }
}

String readDHTHumidity() {
  // Sensor readings may also be up to 2 seconds 'old' (its a very slow sensor)
  float h = dht.readHumidity();
  if (isnan(h)) {
    Serial.println("Failed to read from DHT sensor!");
    return "--";
  }
  else {
    Serial.println(h);
    return String(h);
  }
}

// Replaces placeholder with FRAME state value
//String processor(const String& var){
//  Serial.println(var);
//  if(var == "STATE"){
//    frameState = frame;
//    Serial.print(frameState);
//    return frameState;
//  }
//  return String();
//}

#define wifi_logo_width 75
#define wifi_logo_height 52
static const unsigned char wifi_logo_bits[] PROGMEM = {
  0x00, 0x00, 0x00, 0x00, 0x00, 0x00, 0x00, 0x00, 0x00, 0x00, 0x00, 0x00, 
  0x00, 0x00, 0x00, 0x00, 0x00, 0x00, 0x00, 0x00, 0x00, 0x00, 0x00, 0x00, 
  0x00, 0x00, 0x00, 0x00, 0x00, 0x00, 0x00, 0x00, 0x00, 0x80, 0xFF, 0x1F, 
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  0x00, 0x00, 0x00, 0x00, };

#define logo_arduino_width 69
#define logo_arduino_height 44
static const unsigned char logo_arduino_bits[] PROGMEM = {
  0x00, 0x00, 0x00, 0x00, 0x00, 0x00, 0x00, 0x00, 0x00, 0x00, 0x00, 0x00, 
  0x00, 0x00, 0x00, 0x00, 0x00, 0x00, 0x00, 0x00, 0x00, 0x00, 0x00, 0x00, 
  0x00, 0x00, 0x00, 0x00, 0x00, 0xFE, 0x01, 0x00, 0xFC, 0x07, 0x00, 0x00, 
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  0x00, 0x00, 0x00, 0x00, 0x00, 0x00, 0x00, 0x00, 0x00, 0x00, 0x00, 0x00, 
  };

#define iphone_logo_width 50
#define iphone_logo_height 52
static const unsigned char iphone_logo_bits[] PROGMEM = {
  0x00, 0x00, 0x00, 0x00, 0x00, 0x00, 0x00, 0x00, 0x00, 0x00, 0x00, 0x07, 
  0x00, 0x00, 0x00, 0x00, 0x00, 0xC0, 0x07, 0x00, 0x00, 0x00, 0x00, 0x00, 
  0xF0, 0x07, 0x00, 0x00, 0x00, 0x00, 0x00, 0xF8, 0x07, 0x00, 0x00, 0x00, 
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  0x00, 0x00, 0x00, 0x00, };


#define family_cat_kitty_width 90
#define family_cat_kitty_height 49
static const unsigned char family_cat_kitty_bits[] PROGMEM = {
  0x00, 0x00, 0x00, 0x00, 0x00, 0x00, 0x00, 0x00, 0x00, 0x00, 0x00, 0x00, 
  0x30, 0x1E, 0x00, 0xFC, 0x01, 0x00, 0x00, 0x00, 0xF8, 0x03, 0x00, 0x00, 
  0x30, 0xF0, 0x7F, 0x07, 0x03, 0x00, 0x00, 0x00, 0x0C, 0x0E, 0x00, 0x00, 
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  0x00, 0x00, 0x00, 0x00, 0x00, 0x00, 0x00, 0x00, 0x00, 0x00, 0x00, 0x00, 
  };

#define PS4_width 10
#define PS4_height 7
static const unsigned char PS4_bits[] PROGMEM = {
  0x00, 0x00, 0x00, 0x00, 0xFF, 0x03, 0x45, 0x03, 0x0F, 0x02, 0x01, 0x02, 
  0xFF, 0x03, };

#define icon_humidity_width 15
#define icon_humidity_height 14
static const unsigned char icon_humidity_bits[] PROGMEM = {
  0xE0, 0x03, 0xF8, 0x0F, 0xFC, 0x1F, 0x7E, 0x3F, 0x3E, 0x3E, 0x1F, 0x7C, 
  0x1F, 0x7C, 0x0F, 0x78, 0x0F, 0x78, 0x1E, 0x3C, 0x1E, 0x3C, 0xFC, 0x1F, 
  0xF8, 0x0F, 0xE0, 0x03, };

#define icon_temperature_width 10
#define icon_temperature_height 17
static const unsigned char icon_temperature_bits[] PROGMEM = {
  0x78, 0x00, 0xFC, 0x00, 0xCC, 0x00, 0x84, 0x00, 0x84, 0x00, 0xB4, 0x00, 
  0xB4, 0x00, 0xB4, 0x00, 0xB4, 0x00, 0xB6, 0x01, 0x7B, 0x03, 0x79, 0x02, 
  0x79, 0x02, 0x7B, 0x03, 0x32, 0x01, 0xCE, 0x01, 0x78, 0x00, };

void drawLogoNetwork(void) {
  u8g2.setFont(u8g2_font_m2icon_5_tf);
  u8g2.drawGlyph(2, 7, 83); 
  u8g2.drawGlyph(8, 7, 83);
  u8g2.drawGlyph(14, 7, 83);
  u8g2.drawGlyph(20, 7, 81);
}

void drawKEY(void) {
  u8g2.setFont(u8g2_font_open_iconic_thing_1x_t);
  u8g2.drawGlyph(62, 9, 79);
}

void drawPIN(void) {
  u8g2.setFont(u8g2_font_battery19_tn);                 //Dung luong PIN
  u8g2.setFontDirection(3);
  u8g2.drawGlyph(128, 8, 53);
  u8g2.setFontDirection(0);
}

void drawWIFI(void){
  u8g2.setFont(u8g2_font_open_iconic_embedded_1x_t);
  u8g2.drawGlyph(28, 9, 80);
}

//--------------------GET_TIME_FROM_NTPServer-------------------
//Update Time           

char timeTQ[20], timeClock[20];

// Along with that we need to specify the address of the NTP Server we wish to use. 
// pool.ntp.org is an open NTP project great for things like this.
// The pool.ntp.org automatically picks time servers which are geographically close for you. 
// But if you want to choose explicitly, use one of the sub-zones of pool.ntp.org.
// Area : Asia          // HostName : asia.pool.ntp.org

const char* ntpServer = "pool.ntp.org";
const long  gmtOffset_sec = 25200;         //For UTC+7.00  -- mean 7*60*60 = 25200s
const int   daylightOffset_sec = 3600;     //Change the Daylight offset in milliseconds. 
//If your country observes Daylight saving time set it to 3600. Otherwise, set it to 0.

//char NTP_hour[5];
//char NTP_min[5];
//char NTP_sec[5];
//
//char NTP_dayofweek[10];
//char NTP_day[5];
//char NTP_month[10];
//char NTP_year[5];

//char timeTQ[20], timeClock[20];

void printLocalTime()
{
  struct tm timeinfo;
  if(!getLocalTime(&timeinfo)){
    Serial.println("Failed to obtain time");
    return;
  }
  
  Serial.println(&timeinfo, "%A, %B %d %Y %H:%M:%S");
  //char timeStringBuff[50];
  //strftime(timeStringBuff, sizeof(timeStringBuff), "%A, %B %d %Y %H:%M:%S", &timeinfo);
  //Serial.println(timeStringBuff);
  //strftime(NTP_hour, sizeof(NTP_hour), "%H", &timeinfo);
  //strftime(NTP_min, sizeof(NTP_min), "%M", &timeinfo);
  //strftime(NTP_sec, sizeof(NTP_sec), "%S", &timeinfo);
  //strftime(NTP_dayofweek, sizeof(NTP_dayofweek), "%A", &timeinfo);
  //strftime(NTP_day, sizeof(NTP_month), "%d", &timeinfo);
  //strftime(NTP_month, sizeof(NTP_month), "%B", &timeinfo);
  //strftime(NTP_year, sizeof(NTP_year), "%Y", &timeinfo);
  //Serial.printf("%s, %s %s %s %s:%s:%s", NTP_dayofweek, NTP_month, NTP_day, NTP_year, NTP_hour, NTP_min, NTP_sec);
  //Serial.println("");

  //char timeTQ[50], timeClock[50];
  strftime(timeTQ, sizeof(timeTQ), "%a, %b %d", &timeinfo);          //u8g2.print("MON, JAN 28"); 
  strftime(timeClock, sizeof(timeClock), "%R", &timeinfo);           //u8g2.print("11:32");        //%R <=> %H:%M
}

void drawTIMECLOCK(void){
  u8g2.setFont(u8g2_font_logisoso16_tf);  //16 pixels
  u8g2.setCursor(43, 35);
  u8g2.print(timeClock);
  u8g2.setFont(u8g2_font_7x14_tf);     //10 pixels
  u8g2.setCursor(26, 50);
  u8g2.print(timeTQ);
  u8g2.setFont(u8g2_font_t0_11_tf);     //8 pixels
  if(f==2)
  {
    u8g2.setCursor(5, 63);
    u8g2.print("Press home to unlock");
  }
}

void drawTIME(void){
  u8g2.setFont(u8g2_font_5x8_tf);  //16 pixels
  u8g2.setCursor(55, 8);
  //u8g2.print("11:32");
  u8g2.print(timeClock);
}

#define SUN 0
#define SUN_CLOUD  1
#define CLOUD 2
#define RAIN 3
#define THUNDER 4

void drawWeatherSymbol(u8g2_uint_t x, u8g2_uint_t y, uint8_t symbol)
{
  switch(symbol)
  {
    case SUN:
      u8g2.setFont(u8g2_font_open_iconic_weather_6x_t);
      u8g2.drawGlyph(x+10, y, 69); 
      break;
    case SUN_CLOUD:
      u8g2.setFont(u8g2_font_open_iconic_weather_6x_t);
      u8g2.drawGlyph(x+10, y, 65); 
      break;
    case CLOUD:
      u8g2.setFont(u8g2_font_open_iconic_weather_6x_t);
      u8g2.drawGlyph(x+10, y, 64); 
      break;
    case RAIN:
      u8g2.setFont(u8g2_font_open_iconic_weather_6x_t);
      u8g2.drawGlyph(x+10, y, 67); 
      break;
    case THUNDER:
      u8g2.setFont(u8g2_font_open_iconic_embedded_6x_t);
      u8g2.drawGlyph(x+10, y, 67);
      break;   
  }
}

void drawWeather(uint8_t symbol/*, int degree, int percent*/)
{
  float xx = dht.readTemperature();  int degree = (int)xx;
  float yy = dht.readHumidity()   ;  int percent = (int)yy;
  Serial.println(degree);
  Serial.println(percent);
  drawWeatherSymbol(0, 48, symbol);
  printLocalTime();
  u8g2.setFont(u8g2_font_5x8_tf);         //16 pixels
  u8g2.setCursor(95, 10);                 //70+3
  u8g2.print(timeClock);
  u8g2.setFont(u8g2_font_logisoso16_tf);
  u8g2.setCursor(90, 30);
  u8g2.print(degree);
  u8g2.print("°C");   // requires enableUTF8Print()
  u8g2.setCursor(90, 48);
  u8g2.print(percent);
  u8g2.print("%");
  u8g2.drawXBMP( 73, 14, icon_temperature_width, icon_temperature_height, icon_temperature_bits);
  u8g2.drawXBMP( 70, 33, icon_humidity_width, icon_humidity_height, icon_humidity_bits);       

}

void drawScrollString(int16_t offset, const char *s)
{
  static char buf[36];  // should for screen with up to 256 pixel width 
  size_t len;
  size_t char_offset = 0;
  u8g2_uint_t dx = 0;
  size_t visible = 0;
  

  u8g2.setDrawColor(0);   // clear the scrolling area
  u8g2.drawBox(0, 49, u8g2.getDisplayWidth()-1, u8g2.getDisplayHeight()-1);
  u8g2.setDrawColor(1);   // set the color for the text
    
  
  len = strlen(s);
  if ( offset < 0 )
  {
    char_offset = (-offset)/8;
    dx = offset + char_offset*8;
    if ( char_offset >= u8g2.getDisplayWidth()/8 )
      return;
    visible = u8g2.getDisplayWidth()/8-char_offset+1;
    strncpy(buf, s, visible);
    buf[visible] = '\0';
    u8g2.setFont(u8g2_font_8x13_mf);
    u8g2.drawStr(char_offset*8-dx, 62, buf);
  }
  else
  {
    char_offset = offset / 8;
    if ( char_offset >= len )
      return; // nothing visible
    dx = offset - char_offset*8;
    visible = len - char_offset;
    if ( visible > u8g2.getDisplayWidth()/8+1 )
      visible = u8g2.getDisplayWidth()/8+1;
    strncpy(buf, s+char_offset, visible);
    buf[visible] = '\0';
    u8g2.setFont(u8g2_font_8x13_mf);
    u8g2.drawStr(-dx, 62, buf);
  }
}

void drawX(const char *s, uint8_t symbol/*, int degree, int percent*/)
{
  int16_t offset = -(int16_t)u8g2.getDisplayWidth();
  int16_t len = strlen(s);
  
  u8g2.clearBuffer();         // clear the internal memory
  drawWeather(symbol/*, degree, percent*/);    // draw the icon and degree only once
  for(;;)             // then do the scrolling
  {
  
    drawScrollString(offset, s);        // no clearBuffer required, screen will be partially cleared here
    u8g2.sendBuffer();        // transfer internal memory to the display

    delay(20);
    offset+=2;
    if ( offset > len*8+1 )
      break;
  }
}

void draw(uint8_t symbol) {
  switch(symbol){
    case 0:
          printLocalTime();
          u8g2.drawXBMP( 40, 5, iphone_logo_width, iphone_logo_height,  iphone_logo_bits);
          break;
    case 1:
    case 2:
    case 3:
          printLocalTime();
          drawLogoNetwork();
          drawWIFI();
          drawKEY();
          drawPIN();
          drawTIMECLOCK();
          break;
    case 4:
          printLocalTime();
          drawLogoNetwork();
          drawWIFI();
          drawPIN();
          u8g2.drawXBMP(20, 12, family_cat_kitty_width, family_cat_kitty_height, family_cat_kitty_bits);
          drawTIME();
          u8g2.setFont(u8g2_font_5x7_tf );     //6 pixels
          u8g2.setCursor(1, 63);
          u8g2.print("Exit");
          u8g2.setFont(u8g2_font_5x7_tf );     //6 pixels
          u8g2.setCursor(108, 63);
          u8g2.print("Menu");
          break;
    case 5:
          printLocalTime();
          drawLogoNetwork();
          drawWIFI();
          drawPIN();
          drawTIME();
          u8g2.setFontMode(1);  /* activate transparent font mode */
          u8g2.setDrawColor(1); /* color 1 for the box */
          u8g2.drawBox(28, 3+7, 75, 12);
          u8g2.setFont(u8g2_font_7x14_tf );         
          u8g2.setDrawColor(0);
          u8g2.drawStr(52, 14+7, "Menu");
          u8g2.setFont(u8g2_font_t0_11_tf); 
          u8g2.setDrawColor(1);
          u8g2.drawStr(43, 25+7, "HomeScreen");    //31
          u8g2.setDrawColor(1);
          u8g2.drawStr(43, 35+7, "Weather");
          u8g2.setDrawColor(1);
          u8g2.drawStr(43, 45+7, "FlappyBird");    //30
          u8g2.setDrawColor(1);
          u8g2.drawStr(43, 55+7, "Alarm");
          //ICON Home, Weather, Alarm
          u8g2.setDrawColor(1);
          u8g2.setFont(u8g2_font_open_iconic_thing_1x_t);
          u8g2.drawGlyph(30, 25+7, 75); 
          u8g2.setFont(u8g2_font_open_iconic_weather_1x_t);
          u8g2.drawGlyph(29, 35+7, 64); 
          u8g2.drawXBMP(29, 44, PS4_width, PS4_height, PS4_bits);
          u8g2.setFont(u8g2_font_open_iconic_embedded_1x_t);
          u8g2.drawGlyph(29, 55+7, 65); 
         
          //BUTTON
          u8g2.setFont(u8g2_font_5x7_tf );     //6 pixels
          u8g2.setCursor(1, 63);
          u8g2.print("Exit");
          u8g2.setFont(u8g2_font_5x7_tf );     //6 pixels
          u8g2.setCursor(98, 63);
          u8g2.print("Choose");
          break;
    case 6:
    case 7:
    case 8:
    case 9:
          u8g2.drawXBMP( 30, 0, wifi_logo_width, wifi_logo_height, wifi_logo_bits);
          u8g2.drawBox( 44+14*(f-6), 55, 5, 5);
          break;
    case 10:
          u8g2.setFont(u8g2_font_5x7_tf );     //6 pixels
          u8g2.setCursor(0, 20);
          u8g2.print("What's the weather today?");
          u8g2.setFont(u8g2_font_open_iconic_all_2x_t);
          u8g2.drawGlyph(25, 55, 209);
          u8g2.drawGlyph(50, 55, 81);
          u8g2.setFont(u8g2_font_open_iconic_all_4x_t);
          u8g2.drawGlyph(78, 60, 208);
          break;
    case 11:
          drawX("It's hard to go out!", CLOUD/*, dht.readTemperature(), dht.readHumidity()*/);
          //  draw("What a beautiful day!", SUN, 27, 77);
          //  draw("The sun's come out!", SUN_CLOUD, 19, 55);
          //  draw("It's raining cats and dogs.", RAIN, 8, 82);
          //  draw("That sounds like thunder.", THUNDER, 12, 87);
          //  draw("It's stopped raining", CLOUD, 15, 90);
          break;
    default:
          break;
  }
}

void delayDisplay(uint8_t symbol){
  switch(symbol)
  {
    case 0:
          delay(5000);
          break;
    case 1:
    case 2:
    case 3:
          delay(1000);
          break;
    case 4:
          delay(3000);
          break; 
    case 5:
          delay(5000);
          break; 
    case 6:
    case 7:
    case 8:
    case 9: 
          delay(300);
          break;
    case 10:
          delay(2000);
          break; 
    case 11:
          delay(1000);
          break;
    default:
          break;        
  }
}

void setup(void) {
  /* U8g2 Project: SH1106 Test Board */
  //pinMode(21, OUTPUT);   // SDA
  //pinMode(22, OUTPUT);   // SCL
  //digitalWrite(21, 0);
  //digitalWrite(22, 0);   
  
  u8g2.begin(); 
  u8g2.enableUTF8Print();
  //u8g2.clearBuffer();         // clear the internal memory

  // Serial port for debugging purposes
  Serial.begin(115200);
  
  dht.begin();

  // Initialize SPIFFS
  if(!SPIFFS.begin()){
    Serial.println("An Error has occurred while mounting SPIFFS");
    return;
  }
  
  // Connect to Wi-Fi
  WiFi.begin(ssid, password);
  while (WiFi.status() != WL_CONNECTED) {
    delay(1000);
    Serial.println("Connecting to WiFi..");
  }

  // Print ESP32 Local IP Address
  Serial.println(WiFi.localIP());
  Serial.println("/nCONNECTED");

  //init and get the time
  configTime(gmtOffset_sec, daylightOffset_sec, ntpServer);
  printLocalTime();

  f = 0;
  //begin
  do{
    u8g2.firstPage();
    do {
      draw(f);
    } while ( u8g2.nextPage() );
    delayDisplay(f);
    f++;
  } while(f<12);

  // Route for root / web page
  server.on("/", HTTP_GET, [](AsyncWebServerRequest *request){
    request->send(SPIFFS, "/index.html");
  });
  server.on("/temperature", HTTP_GET, [](AsyncWebServerRequest *request){
    request->send_P(200, "text/plain", readDHTTemperature().c_str());
  });
  server.on("/humidity", HTTP_GET, [](AsyncWebServerRequest *request){
    request->send_P(200, "text/plain", readDHTHumidity().c_str());
  });
  server.on("/1", HTTP_GET, [](AsyncWebServerRequest *request){
    f = 1;             //frame = 1;
    request->send(SPIFFS, "/index.html");
  });
  server.on("/4", HTTP_GET, [](AsyncWebServerRequest *request){
    f = 4;            //frame = 4;
    request->send(SPIFFS, "/index.html");
  });
  server.on("/5", HTTP_GET, [](AsyncWebServerRequest *request){
    f = 5;            //frame = 5;
    request->send(SPIFFS, "/index.html");
  });
  server.on("/6", HTTP_GET, [](AsyncWebServerRequest *request){
    f = 6;            //frame = 6;
    request->send(SPIFFS, "/index.html");
  });
  // Start server
  server.begin();
  
  //disconnect WiFi as it's no longer needed
  //WiFi.disconnect(true);
  //WiFi.mode(WIFI_OFF);
}

void loop(void) {
  u8g2.firstPage();
  do {
     draw(f);
  } while ( u8g2.nextPage() );
  delayDisplay(f);

  if((f>=1)&&(f<3))
  {
    f++;
  }
  else if((f>=6)&&(f<11))
  {
    f++;  
  }
  else if( f == 4)
  {
    //drawFrame
  }
  else if( f == 5)
  {
    //drawFrame
  }
  else 
  {
    //loop
  }
}
